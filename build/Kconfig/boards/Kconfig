## build/Kconfig/boards/Kconfig
```kconfig
# Load Zephyr board Kconfig descriptions.
osource "/home/kaius/ncs/v3.1.0/zephyr/boards/nordic/nrf52840dk/Kconfig"
```

## build/Kconfig/boards/Kconfig.defconfig
```kconfig
# Load Zephyr board defconfig descriptions.
osource "/home/kaius/ncs/v3.1.0/zephyr/boards/nordic/nrf52840dk/Kconfig.defconfig"
```

## build/servo_test/Kconfig/boards/Kconfig.nrf52840dk
```kconfig
# Load board Kconfig descriptions.
osource "/home/kaius/ncs/v3.1.0/zephyr/boards/nordic/nrf52840dk/Kconfig.nrf52840dk"
```

## build_52833/Kconfig/boards/Kconfig.nrf52833dk
```kconfig
# Load board Kconfig descriptions.
osource "/home/kaius/ncs/v3.1.0/zephyr/boards/nordic/nrf52833dk/Kconfig.nrf52833dk"
```

## build_52833/Kconfig/boards/Kconfig.sysbuild
```kconfig
# Load Sysbuild board Kconfig descriptions.
osource "/home/kaius/ncs/v3.1.0/zephyr/boards/nordic/nrf52833dk/Kconfig.sysbuild"
```

## build_52833/servo_test/Kconfig/arch/Kconfig
```kconfig
# Load Zephyr Arch Kconfig descriptions.
osource "/home/kaius/ncs/v3.1.0/zephyr/arch/rx/Kconfig"
osource "/home/kaius/ncs/v3.1.0/zephyr/arch/x86/Kconfig"
osource "/home/kaius/ncs/v3.1.0/zephyr/arch/xtensa/Kconfig"
osource "/home/kaius/ncs/v3.1.0/zephyr/arch/sparc/Kconfig"
osource "/home/kaius/ncs/v3.1.0/zephyr/arch/riscv/Kconfig"
osource "/home/kaius/ncs/v3.1.0/zephyr/arch/posix/Kconfig"
osource "/home/kaius/ncs/v3.1.0/zephyr/arch/mips/Kconfig"
osource "/home/kaius/ncs/v3.1.0/zephyr/arch/arm64/Kconfig"
osource "/home/kaius/ncs/v3.1.0/zephyr/arch/arm/Kconfig"
osource "/home/kaius/ncs/v3.1.0/zephyr/arch/arc/Kconfig"
```
